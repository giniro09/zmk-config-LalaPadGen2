## dts/bindings/behavior/zmk,behavior-iqs9151-cursor-inertia-toggle.yaml
```yaml
description: IQS9151 cursor inertia toggle behavior

compatible: "zmk,behavior-iqs9151-cursor-inertia-toggle"

properties:
  display-name:
    type: string

  label:
    type: string
    required: false
    deprecated: true

  "#binding-cells":
    type: int
    required: true
    const: 0

  target-side:
    type: int
    required: true
    enum:
      - 0
      - 1
    description: |
      Target split side for the toggle behavior.
      0 = peripheral/left, 1 = central/right.

binding-cells: []
```

## dts/bindings/behavior/zmk,behavior-iqs9151-haptic.yaml
```yaml
description: IQS9151 haptic behavior

compatible: "zmk,behavior-iqs9151-haptic"

properties:
  display-name:
    type: string

  label:
    type: string
    required: false
    deprecated: true

  "#binding-cells":
    type: int
    required: true
    const: 1

  target-side:
    type: int
    required: true
    enum:
      - 0
      - 1
    description: |
      Target split side for the haptic behavior.
      0 = peripheral/left, 1 = central/right.

binding-cells:
  - pattern
```

## dts/bindings/behavior/zmk,behavior-trackpad-to-pos.yaml
```yaml
description: Trackpad to position behavior

compatible: "zmk,behavior-trackpad-to-pos"

properties:
  display-name:
    type: string

  label:
    type: string
    required: false
    deprecated: true

  "#binding-cells":
    type: int
    required: true
    const: 1

binding-cells:
  - param1
```

## dts/bindings/behavior/zmk,behavior-zip-dynamic-scale-set.yaml
```yaml
description: Dynamic scale set behavior

compatible: "zmk,behavior-zip-dynamic-scale-set"

properties:
  display-name:
    type: string

  label:
    type: string
    required: false
    deprecated: true

  "#binding-cells":
    type: int
    required: true
    const: 2

binding-cells:
  - param1
  - param2
```

## dts/bindings/haptic/ti,drv2605l.yaml
```yaml
# Copyright (c) 2026
# SPDX-License-Identifier: MIT

description: Minimal DRV2605L I2C haptic node for local firmware helpers

compatible: "ti,drv2605l"

include: i2c-device.yaml
```

## dts/bindings/input/azoteq,iqs9151.yaml
```yaml
description: |
  Azoteq IQS9151 driver placeholder.

compatible: "azoteq,iqs9151"

include: i2c-device.yaml

properties:
  irq-gpios:
    type: phandle-array
    required: true
    description: Interrupt GPIO for IQS9151 driver.
  force-gpios:
    type: phandle-array
    required: false
    description: Optional digital FSR threshold input used for force interaction.
  fsr-device:
    type: phandle
    required: false
    description: Optional external I2C ADC device used for FSR analog input.
  fsr-channel:
    type: int
    required: false
    description: Optional channel index for the external I2C ADC FSR input.
  io-channels:
    type: phandle-array
    required: false
    description: Optional FSR ADC channel used for force interaction input.
  haptic-device:
    type: phandle
    required: false
    description: Optional DRV2605L haptic device on the same I2C bus.
```

## dts/bindings/input_processors/zmk,input-processor-behaviors-consume.yaml
```yaml
# Copyright (c) 2026
# SPDX-License-Identifier: MIT

description: Input processor that invokes behaviors and neutralizes matched events

compatible: "zmk,input-processor-behaviors-consume"

include: ip_zero_param.yaml

properties:
  type:
    type: int
  codes:
    type: array
    required: true
  bindings:
    type: phandle-array
    required: true
```

## dts/bindings/input_processors/zmk,input-processor-dynamic-scaler.yaml
```yaml
# Copyright (c) 2026
# SPDX-License-Identifier: MIT

description: Input processor for applying a dynamic scale factor

compatible: "zmk,input-processor-dynamic-scaler"

include: ip_zero_param.yaml

properties:
  type:
    type: int
    required: true
  codes:
    type: array
    required: true
  scale-group:
    type: int
    default: 0
    description: "Dynamic scale group index (0: XY, 1: Scroll)"
```

## dts/bindings/input_processors/zmk,input-processor-force-caret.yaml
```yaml
# Copyright (c) 2026
# SPDX-License-Identifier: MIT

description: Shared force-hold caret input processor

compatible: "zmk,input-processor-force-caret"

include: ip_zero_param.yaml

properties:
  side:
    type: int
    required: true
  bindings:
    type: phandle-array
    required: true
```

## dts/bindings/input_processors/zmk,input-processor-precision-scaler.yaml
```yaml
# Copyright (c) 2026
# SPDX-License-Identifier: MIT

description: Input processor that scales XY movement during IQS9151 precision mode

compatible: "zmk,input-processor-precision-scaler"

include: ip_zero_param.yaml
```

## input_processors/Kconfig
```kconfig
menuconfig ZMK_INPUT_PROCESSOR_DYNAMIC_SCALER
    bool "Dynamic scaler input processor"
    default y
    select SETTINGS
    help
      Enable a dynamic scaler input processor that applies a persisted scale
      factor to REL events (e.g. cursor and scroll).

if ZMK_INPUT_PROCESSOR_DYNAMIC_SCALER

config ZMK_INPUT_PROCESSOR_DYNAMIC_SCALER_DEFAULT_SCALE_X10
    int "Default dynamic scale (x10)"
    range 2 50
    default 10
    help
      Default scale for the dynamic scaler, stored as value * 10.
      10 = 1.0x, 2 = 0.2x, 50 = 5.0x.

config ZMK_INPUT_PROCESSOR_DYNAMIC_SCALER_MIN_SCALE_X10
    int "Minimum dynamic scale (x10)"
    range 2 50
    default 2
    help
      Minimum scale for the dynamic scaler, stored as value * 10.

config ZMK_INPUT_PROCESSOR_DYNAMIC_SCALER_MAX_SCALE_X10
    int "Maximum dynamic scale (x10)"
    range 2 50
    default 50
    help
      Maximum scale for the dynamic scaler, stored as value * 10.

endif

menuconfig ZMK_INPUT_PROCESSOR_BEHAVIORS_CONSUME
    bool "Behaviors consume input processor"
    default y
    help
      Invoke behaviors for matched events, then neutralize the event so it
      does not generate mouse button output. This avoids relying on STOP
      being honored in layer overrides.

menuconfig ZMK_INPUT_PROCESSOR_FORCE_CARET
    bool "Shared Force/Caret input processor"
    default y
    help
      Watch trackpad Force primary-button holds centrally, allowing either
      trackpad to cancel the hold into drag or drive caret movement after the
      hold becomes caret mode.

if ZMK_INPUT_PROCESSOR_FORCE_CARET

config ZMK_INPUT_PROCESSOR_FORCE_CARET_HOLD_MS
    int "Shared Force/Caret hold delay (ms)"
    range 50 1000
    default 450
    help
      Quiet time after a Force primary-button hold before the shared processor
      releases the button and enters caret mode.

config ZMK_INPUT_PROCESSOR_FORCE_CARET_DEADZONE
    int "Shared Force/Caret deadzone"
    range 1 500
    default 80
    help
      Relative motion amount consumed per emitted arrow key in shared caret
      mode.

config ZMK_INPUT_PROCESSOR_FORCE_CARET_MOVE_THRESHOLD
    int "Shared Force/Caret drag threshold"
    range 1 500
    default 18
    help
      Single relative motion event amount that cancels a pending Force/Caret
      hold into normal drag. Small sensor jitter below this threshold keeps the
      hold eligible for caret mode.

endif

menuconfig ZMK_INPUT_PROCESSOR_PRECISION_SCALER
    bool "Precision scaler input processor"
    default y
    help
      Apply an extra fixed XY scale while the IQS9151 precision pointer mode
      is active.

if ZMK_INPUT_PROCESSOR_PRECISION_SCALER

config ZMK_INPUT_PROCESSOR_PRECISION_SCALER_SCALE_X10
    int "Precision large-motion scale (x10)"
    range 1 10
    default 4
    help
      Extra pointer scale applied during precision pointer mode for larger
      movement deltas. 4 = 0.4x.

config ZMK_INPUT_PROCESSOR_PRECISION_SCALER_MIN_SCALE_X100
    int "Precision maximum-pressure scale (x100)"
    range 5 100
    default 30
    help
      Pointer scale applied at or above the configured maximum force delta.
      30 = 0.30x.

config ZMK_INPUT_PROCESSOR_PRECISION_SCALER_MAX_SCALE_X100
    int "Precision minimum-pressure scale (x100)"
    range 5 100
    default 90
    help
      Pointer scale applied right at precision entry. 90 = 0.90x.

config ZMK_INPUT_PROCESSOR_PRECISION_SCALER_START_FORCE_DELTA
    int "Precision force delta at scale start"
    range 1 32767
    default 5000
    help
      FSR delta at which the linear precision slowdown begins.

config ZMK_INPUT_PROCESSOR_PRECISION_SCALER_MAX_FORCE_DELTA
    int "Precision force delta for maximum slowdown"
    range 100 32767
    default 12000
    help
      FSR delta at which the precision pointer reaches its minimum scale.
      Between entry threshold and this value, scaling changes linearly.

config ZMK_INPUT_PROCESSOR_PRECISION_SCALER_SMALL_THRESHOLD
    int "Precision small-motion threshold"
    range 1 50
    default 2
    help
      Relative delta magnitude at or below which precision mode uses the
      small-motion scale.

config ZMK_INPUT_PROCESSOR_PRECISION_SCALER_MEDIUM_THRESHOLD
    int "Precision medium-motion threshold"
    range 2 100
    default 6
    help
      Relative delta magnitude at or below which precision mode uses the
      medium-motion scale. Larger deltas use the large-motion scale.

config ZMK_INPUT_PROCESSOR_PRECISION_SCALER_SMALL_SCALE_X10
    int "Precision small-motion scale (x10)"
    range 1 10
    default 8
    help
      Extra pointer scale applied during precision pointer mode for tiny
      movement deltas. 8 = 0.8x.

config ZMK_INPUT_PROCESSOR_PRECISION_SCALER_MEDIUM_SCALE_X10
    int "Precision medium-motion scale (x10)"
    range 1 10
    default 6
    help
      Extra pointer scale applied during precision pointer mode for medium
      movement deltas. 6 = 0.6x.

endif
```
